## kernel/pgo/Kconfig
```kconfig
# SPDX-License-Identifier: GPL-2.0-only
menu "Profile Guided Optimization (PGO) (EXPERIMENTAL)"

config ARCH_SUPPORTS_PGO_CLANG
	bool

config PGO_CLANG
	bool "Enable clang's PGO-based kernel profiling"
	depends on DEBUG_FS
	depends on ARCH_SUPPORTS_PGO_CLANG
	depends on CC_IS_CLANG
	depends on !ARCH_WANTS_NO_INSTR || CC_HAS_NO_PROFILE_FN_ATTR
	help
	  This option enables clang's PGO (Profile Guided Optimization) based
	  code profiling to better optimize the kernel.

	  If unsure, say N.

	  Run a representative workload for your application on a kernel
	  compiled with this option and read the raw profile files from
	  /sys/kernel/debug/pgo/*.profraw. These files need to be
	  processed with llvm-profdata.

	  The profiler creates files for each online cpu and running module:
	  vmlinux.*.profraw, ext4.*.profraw, and so on.
	  The profile data files may be merged with other collected
	  raw profiles.

	  Copy the processed profile file into vmlinux.profdata, and enable
	  KCFLAGS=-fprofile-use=vmlinux.profdata to produce an optimized
	  kernel.
	  PGO_CLANG must be disabled when compiling optimized kernel.
	  The used .config should otherwise be the same. Clang can tolerate
	  small mismatches in the profile data but with caveat that any
	  mismatching profile data is ignored.

	  Note that a kernel compiled with profiling flags will be
	  significantly larger and run slower. Also be sure to exclude files
	  from profiling which are not linked to the kernel image to prevent
	  linker errors.

	  Note that the debugfs filesystem has to be mounted to access
	  profiling data.

endmenu
```
